## ESP32_CallNotifier/sdkconfig.defaults
```kconfig
CONFIG_BT_ENABLED=y
CONFIG_BT_BLUEDROID_ENABLED=y
CONFIG_BT_CLASSIC_ENABLED=y
CONFIG_BT_HFP_HF_ENABLE=y
CONFIG_BT_HFP_AUDIO_DATA_PATH_PCM=y
CONFIG_BT_SSP_ENABLED=y
CONFIG_ESP_COEX_SW_COEXIST_ENABLE=y
CONFIG_PM_ENABLE=n
```
